## main/Kconfig.projbuild
```kconfig
menu "PulseOx Bridge Configuration"

    config PULSEOX_WIFI_SSID
        string "WiFi SSID"
        default "jiamdaole"
        help
            WiFi STA mode SSID to connect to.

    config PULSEOX_WIFI_PASSWORD
        string "WiFi Password"
        default "12345678"
        help
            WiFi STA mode password.

    config PULSEOX_MQTT_BROKER_URI
        string "MQTT Broker URI"
        default "mqtt://172.20.10.4"
        help
            MQTT broker URI (e.g. mqtt://192.168.1.100 or mqtts://hostname).

    config PULSEOX_MQTT_PUBLISH_TOPIC
        string "MQTT Publish Topic"
        default "pulseox/data"
        help
            MQTT topic for publishing STM32 sensor data upstream.

    config PULSEOX_MQTT_STATUS_TOPIC
        string "MQTT Status Topic"
        default "pulseox/status"
        help
            MQTT topic for ESP32 bridge health/status messages.

    config PULSEOX_MQTT_COMMAND_TOPIC
        string "MQTT Command Topic"
        default "pulseox/cmd"
        help
            MQTT topic for receiving downstream commands.

    config PULSEOX_UART_PORT
        int "UART Port Number"
        range 0 2
        default 1
        help
            UART port number (ESP32-C3 typically uses UART_NUM_1).

    config PULSEOX_UART_TX_PIN
        int "UART TX Pin"
        default 7
        help
            GPIO pin for UART TX (ESP32 to STM32).

    config PULSEOX_UART_RX_PIN
        int "UART RX Pin"
        default 3
        help
            GPIO pin for UART RX (STM32 to ESP32).

    config PULSEOX_UART_BAUD
        int "UART Baud Rate"
        default 115200
        help
            UART baud rate for STM32 communication.

    config PULSEOX_USB_TRANSPORT_ENABLED
        bool "Enable USB Transport"
        default y
        help
            Enable USB Serial/JTAG as an alternative PC uplink channel.
            When enabled, GUI can activate USB session to bypass MQTT.

endmenu
```
